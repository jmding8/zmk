## app/boards/shields/adagio/Kconfig.defconfig
```kconfig
if SHIELD_ADAGIO_LEFT

config ZMK_KEYBOARD_NAME
	default "Adagio-L"

config ZMK_SPLIT_BLE_ROLE_CENTRAL
	default y

endif


if SHIELD_ADAGIO_RIGHT

config ZMK_KEYBOARD_NAME
	default "Adagio-R"

endif


if SHIELD_ADAGIO_LEFT || SHIELD_ADAGIO_RIGHT

config ZMK_SPLIT
	default y

endif
```

## app/boards/shields/adagio/Kconfig.shield
```kconfig
config SHIELD_ADAGIO_LEFT
	def_bool $(shields_list_contains,adagio_left)

config SHIELD_ADAGIO_RIGHT
	def_bool $(shields_list_contains,adagio_right)
```

## app/boards/shields/andante/Kconfig.shield
```kconfig
config SHIELD_ANDANTE_LEFT
	def_bool $(shields_list_contains,andante_left)

config SHIELD_ANDANTE_RIGHT
	def_bool $(shields_list_contains,andante_right)
```

## app/boards/shields/lemma/Kconfig.defconfig
```kconfig
# Copyright (c) 2020 Pete Johanson, Richard Jones
# SPDX-License-Identifier: MIT

if SHIELD_LEMMA_LEFT

config ZMK_KEYBOARD_NAME
	default "Lemma-L"

endif


if SHIELD_LEMMA_RIGHT

config ZMK_KEYBOARD_NAME
	default "Lemma-R"

endif
```

## app/boards/shields/lemma/Kconfig.shield
```kconfig
# Copyright (c) 2020 Pete Johanson, Jamie Ding
# SPDX-License-Identifier: MIT

config SHIELD_LEMMA_LEFT
	def_bool $(shields_list_contains,lemma_left)

config SHIELD_LEMMA_RIGHT
	def_bool $(shields_list_contains,lemma_right)
```
